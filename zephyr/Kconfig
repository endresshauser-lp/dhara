## zephyr/Kconfig
```kconfig
# Flash translation layer disk driver configuration options

config DISK_DRIVER_FTL
	bool "Flash translation layer"
	default y
	depends on DT_HAS_ZEPHYR_FTL_DHARA_ENABLED
	depends on DISK_DRIVERS
	select FLASH_EX_OP_ENABLED
	help
	  Enable flash translation layer disk driver for NAND flashes. Only the Dhara implementation
	  is currently available.

if DISK_DRIVER_FTL

module = DISK_FTL
module-str = disk_ftl
source "subsys/logging/Kconfig.template.log_config"

endif # DISK_DRIVER_FTL
```

## zephyr/dts/bindings/disk/zephyr,ftl-dhara.yaml
```yaml
description: |
  Flash translation layer disk driver with Dhara implementation on flash partition.

compatible: "zephyr,ftl-dhara"

properties:
  partition:
    type: phandle
    required: true
    description: |
      Backing storage flash map partition.

  disk-name:
    type: string
    required: true
    description: |
      Disk name.

  buffer-size:
    type: int
    required: true
    description: |
      Buffer size in bytes for the FTL driver. Must be equal to the page size of the backing flash.

  gc-ratio:
    type: int
    required: false
    default: 15
    description: |
      Garbage collection ratio for the FTL driver. This is the ratio of garbage collection
      operations to real writes when automatic collection is active. Smaller values lead to faster
      and more predictable input/output at the expense of capacity.
```
